&behavior-swipe {
    compatible = "zmk,behavior-mod-morph";
    label = "LGUI_1";
    #binding-cells = <0>;
    bindings = <&kp 0xE3 &kp 0x1E>; // LGUI + 1
};

&behavior-swipe-shift {
    compatible = "zmk,behavior-mod-morph";
    label = "LSFT_LGUI_1";
    #binding-cells = <0>;
    bindings = <&kp 0xE1 &kp 0xE3 &kp 0x1E>; // LSFT + LGUI + 1
};
